## esp-sensor/main/Kconfig.projbuild
```kconfig
menu "Demeter"
  config WIFI_SSID
    string "WiFi Network Name"
    default ""
    help
      The name of the network to connect to
  config WIFI_PASSWORD
    string "WiFi Password"
    default ""
    help
      The password to use when connecting to wifi

  config WEBSOCKET_URL
    string "WebSocket URL"
    default ""
    help
      The URL of the WebSocket server to connect to, like ws://1.2.3.4:8123/api/websocket/sensors

  menu "DS18B20 (Water Temperature)"
    config DS18B20_GPIO
      int "DS18B20 GPIO Pin"
      default 0
      help
        The GPIO pin to use for the DS18B20 sensor
    config DS18B20_SYSTEM_ID
      int "DS18B20 System ID"
      default 0
      help
        The system ID to use for the DS18B20 sensor
  endmenu

  menu "I2C"
    config I2C_CLOCK_GPIO
        int "I2C Clock Pin"
        default 0
        help
            The clock GPIO pin for an SHT41/2/etc
    config I2C_DATA_GPIO
        int "I2C Data Pin"
        default 0
        help
            The data GPIO pin for an SHT41/2/etc
  endmenu
  menu "SHT 4x"
    config SHT_ENCLOSURE_ID
        int "SHT Enclosure ID"
        default 0
        help
            The ID of the enclosure this SHT device measures for.
  endmenu
  menu "BH1750"
    config BH_PLANT_SITE_ID
        int "BH1750 Plant Site ID"
        default 0
        help
            The ID of the plant site this BH1750 measures for.
  endmenu
endmenu
```
